# MSP432E411Y register map
Vendor: Texas Instruments; File version: 3.200
ARM Cortex-M4 MSP432E4 Device
CPU: CM4 r1p2, little endian, no MPU, no FPU, 0x3 interrupt priority bits, 0x0 interrupts
Registers are 32-bit, read-write, no defined reset value unless marked. A register's access mark holds for its fields unless they carry their own. Offsets are from the block's base; lines under a group give offsets from that group; [hi:lo] are bit positions; {n}, {i} and the like mark numbered series; 'fields as' and 'values as' point back to an identical list; <NAME> marks a mode.

## Memory map
0x40000000 WATCHDOG0 size 0x1000 — Register map for WATCHDOG0 peripheral
0x40001000 WATCHDOG1 size 0x1000 — Register map for WATCHDOG0 peripheral
0x40008000 SSI0 size 0x1000 — Register map for SSI0 peripheral
0x40009000 SSI1 size 0x1000 — Register map for SSI0 peripheral
0x4000A000 SSI2 size 0x1000 — Register map for SSI0 peripheral
0x4000B000 SSI3 size 0x1000 — Register map for SSI0 peripheral
{0x4000C000+0x1000*n} UART{n} size 0x1000 (n=0..7) — Register map for UART0 peripheral
0x40020000 I2C0 size 0x1000 — Register map for I2C0 peripheral
0x40021000 I2C1 size 0x1000 — Register map for I2C0 peripheral
0x40022000 I2C2 size 0x1000 — Register map for I2C0 peripheral
0x40023000 I2C3 size 0x1000 — Register map for I2C0 peripheral
0x40028000 PWM0 size 0x1000 — Register map for PWM0 peripheral
0x4002C000 QEI0 size 0x1000 — Register map for QEI0 peripheral
0x40030000 TIMER0 size 0x1000 — Register map for TIMER0 peripheral
0x40031000 TIMER1 size 0x1000 — Register map for TIMER0 peripheral
0x40032000 TIMER2 size 0x1000 — Register map for TIMER0 peripheral
0x40033000 TIMER3 size 0x1000 — Register map for TIMER0 peripheral
0x40034000 TIMER4 size 0x1000 — Register map for TIMER0 peripheral
0x40035000 TIMER5 size 0x1000 — Register map for TIMER0 peripheral
0x40038000 ADC0 size 0x1000 — Register map for ADC0 peripheral
0x40039000 ADC1 size 0x1000 — Register map for ADC0 peripheral
0x4003C000 COMP size 0x1000 — Register map for COMP peripheral
0x40040000 CAN0 size 0x1000 — Register map for CAN0 peripheral
0x40041000 CAN1 size 0x1000 — Register map for CAN0 peripheral
0x40050000 USB0 size 0x1000 — Register map for USB0 peripheral
0x40058000 GPIOA size 0x1000 — Register map for GPIOA peripheral
0x40059000 GPIOB size 0x1000 — Register map for GPIOA peripheral
0x4005A000 GPIOC size 0x1000 — Register map for GPIOA peripheral
0x4005B000 GPIOD size 0x1000 — Register map for GPIOA peripheral
0x4005C000 GPIOE size 0x1000 — Register map for GPIOA peripheral
0x4005D000 GPIOF size 0x1000 — Register map for GPIOA peripheral
0x4005E000 GPIOG size 0x1000 — Register map for GPIOA peripheral
0x4005F000 GPIOH size 0x1000 — Register map for GPIOA peripheral
0x40060000 GPIOJ size 0x1000 — Register map for GPIOA peripheral
0x40061000 GPIOK size 0x1000 — Register map for GPIOA peripheral
0x40062000 GPIOL size 0x1000 — Register map for GPIOA peripheral
0x40063000 GPIOM size 0x1000 — Register map for GPIOA peripheral
0x40064000 GPION size 0x1000 — Register map for GPIOA peripheral
0x40065000 GPIOP size 0x1000 — Register map for GPIOA peripheral
0x40066000 GPIOQ size 0x1000 — Register map for GPIOA peripheral
0x40067000 GPIOR size 0x1000 — Register map for GPIOA peripheral
0x40068000 GPIOS size 0x1000 — Register map for GPIOA peripheral
0x40069000 GPIOT size 0x1000 — Register map for GPIOA peripheral
0x400AF000 EEPROM size 0x1000 — Register map for EEPROM peripheral
0x400B6000 ONEWIRE0 size 0x1000 — Register map for ONEWIRE0 peripheral
0x400B8000 I2C8 size 0x1000 — Register map for I2C0 peripheral
0x400B9000 I2C9 size 0x1000 — Register map for I2C0 peripheral
0x400C0000 I2C4 size 0x1000 — Register map for I2C0 peripheral
0x400C1000 I2C5 size 0x1000 — Register map for I2C0 peripheral
0x400C2000 I2C6 size 0x1000 — Register map for I2C0 peripheral
0x400C3000 I2C7 size 0x1000 — Register map for I2C0 peripheral
0x400D0000 EPI0 size 0x1000 — Register map for EPI0 peripheral
0x400E0000 TIMER6 size 0x1000 — Register map for TIMER0 peripheral
0x400E1000 TIMER7 size 0x1000 — Register map for TIMER0 peripheral
0x400EC000 EMAC0 size 0x1000 — Register map for EMAC0 peripheral
0x400F9000 SYSEXC size 0x1000 — Register map for SYSEXC peripheral
0x400FC000 HIB size 0x1000 — Register map for HIB peripheral
0x400FD000 FLASH_CTRL size 0x1000 — Register map for FLASH_CTRL peripheral
0x400FE000 SYSCTL size 0x1000 — Register map for SYSCTL peripheral
0x400FF000 UDMA size 0x1000 — Register map for UDMA peripheral
0x44030010 SHAMD5_DMA size 0x10 — Register map for SHAMD5 DMA peripheral
0x44030020 AES_DMA size 0x10 — Register map for AES DMA peripheral
0x44030030 DES_DMA size 0x10 — Register map for DES DMA peripheral
0x44030204 CCM0 size 0x4 — Register map for CCM0 peripheral
0x44030400 CRC size 0x1C — Register map for CRC peripheral
0x44034000 SHAMD5 size 0x2000 — Register map for SHAMD5 peripheral
0x44036000 AES size 0x2000 — Register map for AES peripheral
0x44038000 DES size 0x2000 — Register map for DES peripheral
0x44050000 LCD0 size 0x1000 — Register map for LCD0 peripheral

## Interrupts
0 GPIOA
1 GPIOB
2 GPIOC
3 GPIOD
4 GPIOE
5 UART0
6 UART1
7 SSI0
8 I2C0
9 PWM0_FAULT (PWM0)
10 PWM0_0 (PWM0)
11 PWM0_1 (PWM0)
12 PWM0_2 (PWM0)
13 QEI0
14 ADC0SS0 (ADC0)
15 ADC0SS1 (ADC0)
16 ADC0SS2 (ADC0)
17 ADC0SS3 (ADC0)
18 WATCHDOG0 (WATCHDOG0, WATCHDOG1)
19 TIMER0A (TIMER0)
20 TIMER0B (TIMER0)
21 TIMER1A (TIMER1)
22 TIMER1B (TIMER1)
23 TIMER2A (TIMER2)
24 TIMER2B (TIMER2)
25 COMP0 (COMP)
26 COMP1 (COMP)
27 COMP2 (COMP)
28 SYSCTL
29 FLASH_CTRL
30 GPIOF
31 GPIOG
32 GPIOH
33 UART2
34 SSI1
35 TIMER3A (TIMER3)
36 TIMER3B (TIMER3)
37 I2C1
38 CAN0
39 CAN1
40 EMAC0
41 HIB
42 USB0
43 PWM0_3 (PWM0)
44 UDMA
45 UDMAERR (UDMA)
46 ADC1SS0 (ADC1)
47 ADC1SS1 (ADC1)
48 ADC1SS2 (ADC1)
49 ADC1SS3 (ADC1)
50 EPI0
51 GPIOJ
52 GPIOK
53 GPIOL
54 SSI2
55 SSI3
56 UART3
57 UART4
58 UART5
59 UART6
60 UART7
61 I2C2
62 I2C3
63 TIMER4A (TIMER4)
64 TIMER4B (TIMER4)
65 TIMER5A (TIMER5)
66 TIMER5B (TIMER5)
67 SYSEXC
70 I2C4
71 I2C5
72 GPIOM
73 GPION
{n+76} GPIOP{n} (GPIOP) (n=0..7)
{n+84} GPIOQ{n} (GPIOQ) (n=0..7)
92 GPIOR
93 GPIOS
97 LCD0
98 TIMER6A (TIMER6)
99 TIMER6B (TIMER6)
100 TIMER7A (TIMER7)
101 TIMER7B (TIMER7)
102 I2C6
103 I2C7
105 ONEWIRE0
109 I2C8
110 I2C9
111 GPIOT
