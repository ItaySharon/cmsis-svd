# MSP432P411V register map
Vendor: Texas Instruments; File version: 3.230
ARM Cortex-M4 MSP432P4xx Device
CPU: 
Registers are 32-bit, read-write, reset 0x0 unless marked. A register's access mark holds for its fields unless they carry their own. Offsets are from the block's base; lines under a group give offsets from that group; [hi:lo] are bit positions; {n}, {i} and the like mark numbered series; 'fields as' and 'values as' point back to an identical list; <NAME> marks a mode.

## Memory map
0x00201000 TLV size 0x15C
0x40000000 TIMER_A0 size 0x30
0x40000400 TIMER_A1 size 0x30
0x40000800 TIMER_A2 size 0x30
0x40000C00 TIMER_A3 size 0x30
0x40001000 EUSCI_A0 size 0x20
0x40001400 EUSCI_A1 size 0x20
0x40001800 EUSCI_A2 size 0x20
0x40001C00 EUSCI_A3 size 0x20
0x40002000 EUSCI_B0 size 0x30
0x40002400 EUSCI_B1 size 0x30
0x40002800 EUSCI_B2 size 0x30
0x40002C00 EUSCI_B3 size 0x30
0x40003000 REF_A size 0xC
0x40003400 COMP_E0 size 0x10
0x40003800 COMP_E1 size 0x10
0x40003C00 AES256 size 0x10
0x40004000 CRC32 size 0x20
0x40004400 RTC_C size 0x20
0x40004800 WDT_A size 0xE
0x40004C00 DIO size 0x138
0x40005000 PMAP size 0x40
0x40005400 CAPTIO0 size 0x10
0x40005800 CAPTIO1 size 0x10
0x4000C000 TIMER32 size 0xF0C
0x4000E000 DMA size 0x1050
0x40010000 PCM size 0x14
0x40010400 CS size 0x68
0x40010800 PSS size 0x40
0x40011000 FLCTL_A size 0x260
0x40012000 ADC14 size 0x158
0x40012400 LCD_F size 0x1A8
0xE0000000 ITM size 0x1000
0xE0001000 DWT size 0x1000
0xE0002000 FPB size 0x1000
0xE000E000 SystemControlSpace size 0x1000 — System Control Space for ARM core: SCnSCB, SCB, SysTick, NVIC, CoreDebug, MPU, FPU
0xE0042000 RSTCTL size 0x128
0xE0043000 SYSCTL_A size 0x102C

## Interrupts
0 PSS_IRQ (PSS)
1 CS_IRQ (CS)
2 PCM_IRQ (PCM)
3 WDT_A_IRQ (WDT_A)
4 FPU_IRQ (SystemControlSpace)
5 FLCTL_A_IRQ (FLCTL_A)
6 COMP_E0_IRQ (COMP_E0)
7 COMP_E1_IRQ (COMP_E1)
8 TA0_0_IRQ (TIMER_A0)
9 TA0_N_IRQ (TIMER_A0)
10 TA1_0_IRQ (TIMER_A1)
11 TA1_N_IRQ (TIMER_A1)
12 TA2_0_IRQ (TIMER_A2)
13 TA2_N_IRQ (TIMER_A2)
14 TA3_0_IRQ (TIMER_A3)
15 TA3_N_IRQ (TIMER_A3)
16 EUSCIA0_IRQ (EUSCI_A0)
17 EUSCIA1_IRQ (EUSCI_A1)
18 EUSCIA2_IRQ (EUSCI_A2)
19 EUSCIA3_IRQ (EUSCI_A3)
20 EUSCIB0_IRQ (EUSCI_B0)
21 EUSCIB1_IRQ (EUSCI_B1)
22 EUSCIB2_IRQ (EUSCI_B2)
23 EUSCIB3_IRQ (EUSCI_B3)
24 ADC14_IRQ (ADC14)
25 T32_INT1_IRQ (TIMER32)
26 T32_INT2_IRQ (TIMER32)
27 T32_INTC_IRQ (TIMER32)
28 AES256_IRQ (AES256)
29 RTC_C_IRQ (RTC_C)
30 DMA_ERR_IRQ (DMA)
31 DMA_INT3_IRQ (DMA)
32 DMA_INT2_IRQ (DMA)
33 DMA_INT1_IRQ (DMA)
34 DMA_INT0_IRQ (DMA)
35 PORT1_IRQ (DIO)
36 PORT2_IRQ (DIO)
37 PORT3_IRQ (DIO)
38 PORT4_IRQ (DIO)
39 PORT5_IRQ (DIO)
40 PORT6_IRQ (DIO)
41 LCD_F_IRQ (LCD_F)

## TLV
Base 0x00201000
0x00 TLV_CHECKSUM ro
0x04 DEVICE_INFO_TAG ro reset 0xB
0x08 DEVICE_INFO_LEN ro — Device Info Length
0x0C DEVICE_ID ro
0x10 HWREV ro — HW Revision
0x14 BCREV ro — Boot Code Revision
0x18 ROM_DRVLIB_REV ro — ROM Driver Library Revision
0x1C DIE_REC_TAG ro reset 0xC — Die Record Tag
0x20 DIE_REC_LEN ro — Die Record Length
0x24 DIE_XPOS ro — Die X-Position
0x28 DIE_YPOS ro — Die Y-Position
0x2C WAFER_ID ro
0x30 LOT_ID ro
0x40 TEST_RESULTS ro
0x44 CS_CAL_TAG ro reset 0x3 — Clock System Calibration Tag
0x48 CS_CAL_LEN ro — Clock System Calibration Length
0x4C DCOIR_FCAL_RSEL04 ro — DCO IR mode: Frequency calibration for DCORSEL 0 to 4
0x50 DCOIR_FCAL_RSEL5 ro — DCO IR mode: Frequency calibration for DCORSEL 5
0x64 DCOIR_CONSTK_RSEL04 ro — DCO IR mode: DCO Constant (K) for DCORSEL 0 to 4
0x68 DCOIR_CONSTK_RSEL5 ro — DCO IR mode: DCO Constant (K) for DCORSEL 5
0x6C DCOER_FCAL_RSEL04 ro — DCO ER mode: Frequency calibration for DCORSEL 0 to 4
0x70 DCOER_FCAL_RSEL5 ro — DCO ER mode: Frequency calibration for DCORSEL 5
0x84 DCOER_CONSTK_RSEL04 ro — DCO ER mode: DCO Constant (K) for DCORSEL 0 to 4
0x88 DCOER_CONSTK_RSEL5 ro — DCO ER mode: DCO Constant (K) for DCORSEL 5
0x8C ADC14_CAL_TAG ro reset 0x5 — ADC14 Calibration Tag
0x90 ADC14_CAL_LEN ro — ADC14 Calibration Length
0x94 ADC_GAIN_FACTOR ro
0x98 ADC_OFFSET ro
0xDC ADC14_REF1P2V_TS30C ro — ADC14 1.2V Reference Temp. Sensor 30C
0xE0 ADC14_REF1P2V_TS85C ro — ADC14 1.2V Reference Temp. Sensor 85C
0xE4 ADC14_REF1P45V_TS30C ro — ADC14 1.45V Reference Temp. Sensor 30C
0xE8 ADC14_REF1P45V_TS85C ro — ADC14 1.45V Reference Temp. Sensor 85C
0xEC ADC14_REF2P5V_TS30C ro — ADC14 2.5V Reference Temp. Sensor 30C
0xF0 ADC14_REF2P5V_TS85C ro — ADC14 2.5V Reference Temp. Sensor 85C
0xF4 REF_CAL_TAG ro reset 0x8 — REF Calibration Tag
0xF8 REF_CAL_LEN ro — REF Calibration Length
0xFC REF_1P2V ro — REF 1.2V Reference
0x100 REF_1P45V ro — REF 1.45V Reference
0x104 REF_2P5V ro — REF 2.5V Reference
0x108 FLASH_INFO_TAG ro reset 0x4
0x10C FLASH_INFO_LEN ro — Flash Info Length
0x110 FLASH_MAX_PROG_PULSES ro — Flash Maximum Programming Pulses
0x114 FLASH_MAX_ERASE_PULSES ro — Flash Maximum Erase Pulses
0x118 RANDOM_NUM_TAG ro reset 0xD — 128-bit Random Number Tag
0x11C RANDOM_NUM_LEN ro — 128-bit Random Number Length
{0x11C+4i} RANDOM_NUM_{i} ro (i=1..4) — 32-bit Random Number {i}
0x130 BSL_CFG_TAG ro reset 0xF — BSL Configuration Tag
0x134 BSL_CFG_LEN ro — BSL Configuration Length
0x138 BSL_PERIPHIF_SEL ro — BSL Peripheral Interface Selection
0x13C BSL_PORTIF_CFG_UART ro — BSL Port Interface Configuration for UART
0x140 BSL_PORTIF_CFG_SPI ro — BSL Port Interface Configuration for SPI
0x144 BSL_PORTIF_CFG_I2C ro — BSL Port Interface Configuration for I2C
0x148 TLV_END ro reset 0xBD0E11D — TLV End Word
