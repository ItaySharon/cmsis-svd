# TM4C123GH6ZRB register map
Vendor: Texas Instruments; File version: 11073
ARM Cortex-M4 Tiva TM4C Device
CPU: CM4 r1p2, little endian, no MPU, no FPU, 0x3 interrupt priority bits, 0x0 interrupts
Registers are 32-bit, read-write, no defined reset value unless marked. A register's access mark holds for its fields unless they carry their own. Offsets are from the block's base; lines under a group give offsets from that group; [hi:lo] are bit positions; {n}, {i} and the like mark numbered series; 'fields as' and 'values as' point back to an identical list; <NAME> marks a mode.

## Memory map
0x40000000 WATCHDOG0 size 0x1000 — Register map for WATCHDOG0 peripheral
0x40001000 WATCHDOG1 size 0x1000 — Register map for WATCHDOG0 peripheral
0x40004000 GPIOA size 0x1000 — Register map for GPIOA peripheral
0x40005000 GPIOB size 0x1000 — Register map for GPIOA peripheral
0x40006000 GPIOC size 0x1000 — Register map for GPIOA peripheral
0x40007000 GPIOD size 0x1000 — Register map for GPIOA peripheral
0x40008000 SSI0 size 0x1000 — Register map for SSI0 peripheral
0x40009000 SSI1 size 0x1000 — Register map for SSI0 peripheral
0x4000A000 SSI2 size 0x1000 — Register map for SSI0 peripheral
0x4000B000 SSI3 size 0x1000 — Register map for SSI0 peripheral
{0x4000C000+0x1000*n} UART{n} size 0x1000 (n=0..7) — Register map for UART0 peripheral
0x40020000 I2C0 size 0x1000 — Register map for I2C0 peripheral
0x40021000 I2C1 size 0x1000 — Register map for I2C0 peripheral
0x40022000 I2C2 size 0x1000 — Register map for I2C0 peripheral
0x40023000 I2C3 size 0x1000 — Register map for I2C0 peripheral
0x40024000 GPIOE size 0x1000 — Register map for GPIOA peripheral
0x40025000 GPIOF size 0x1000 — Register map for GPIOA peripheral
0x40026000 GPIOG size 0x1000 — Register map for GPIOA peripheral
0x40027000 GPIOH size 0x1000 — Register map for GPIOA peripheral
0x40028000 PWM0 size 0x1000 — Register map for PWM0 peripheral
0x40029000 PWM1 size 0x1000 — Register map for PWM0 peripheral
0x4002C000 QEI0 size 0x1000 — Register map for QEI0 peripheral
0x4002D000 QEI1 size 0x1000 — Register map for QEI0 peripheral
0x40030000 TIMER0 size 0x1000 — Register map for TIMER0 peripheral
0x40031000 TIMER1 size 0x1000 — Register map for TIMER0 peripheral
0x40032000 TIMER2 size 0x1000 — Register map for TIMER0 peripheral
0x40033000 TIMER3 size 0x1000 — Register map for TIMER0 peripheral
0x40034000 TIMER4 size 0x1000 — Register map for TIMER0 peripheral
0x40035000 TIMER5 size 0x1000 — Register map for TIMER0 peripheral
0x40036000 WTIMER0 size 0x1000 — Register map for WTIMER0 peripheral
0x40037000 WTIMER1 size 0x1000 — Register map for TIMER0 peripheral
0x40038000 ADC0 size 0x1000 — Register map for ADC0 peripheral
0x40039000 ADC1 size 0x1000 — Register map for ADC0 peripheral
0x4003C000 COMP size 0x1000 — Register map for COMP peripheral
0x4003D000 GPIOJ size 0x1000 — Register map for GPIOA peripheral
0x40040000 CAN0 size 0x1000 — Register map for CAN0 peripheral
0x40041000 CAN1 size 0x1000 — Register map for CAN0 peripheral
0x4004C000 WTIMER2 size 0x1000 — Register map for TIMER0 peripheral
0x4004D000 WTIMER3 size 0x1000 — Register map for TIMER0 peripheral
0x4004E000 WTIMER4 size 0x1000 — Register map for TIMER0 peripheral
0x4004F000 WTIMER5 size 0x1000 — Register map for TIMER0 peripheral
0x40050000 USB0 size 0x1000 — Register map for USB0 peripheral
0x40058000 GPIOA_AHB size 0x1000 — Register map for GPIOA peripheral
0x40059000 GPIOB_AHB size 0x1000 — Register map for GPIOA peripheral
0x4005A000 GPIOC_AHB size 0x1000 — Register map for GPIOA peripheral
0x4005B000 GPIOD_AHB size 0x1000 — Register map for GPIOA peripheral
0x4005C000 GPIOE_AHB size 0x1000 — Register map for GPIOA peripheral
0x4005D000 GPIOF_AHB size 0x1000 — Register map for GPIOA peripheral
0x4005E000 GPIOG_AHB size 0x1000 — Register map for GPIOA peripheral
0x4005F000 GPIOH_AHB size 0x1000 — Register map for GPIOA peripheral
0x40060000 GPIOJ_AHB size 0x1000 — Register map for GPIOA peripheral
0x40061000 GPIOK size 0x1000 — Register map for GPIOA peripheral
0x40062000 GPIOL size 0x1000 — Register map for GPIOA peripheral
0x40063000 GPIOM size 0x1000 — Register map for GPIOA peripheral
0x40064000 GPION size 0x1000 — Register map for GPIOA peripheral
0x40065000 GPIOP size 0x1000 — Register map for GPIOA peripheral
0x40066000 GPIOQ size 0x1000 — Register map for GPIOA peripheral
0x400AF000 EEPROM size 0x1000 — Register map for EEPROM peripheral
0x400C0000 I2C4 size 0x1000 — Register map for I2C0 peripheral
0x400C1000 I2C5 size 0x1000 — Register map for I2C0 peripheral
0x400F9000 SYSEXC size 0x1000 — Register map for SYSEXC peripheral
0x400FC000 HIB size 0x1000 — Register map for HIB peripheral
0x400FD000 FLASH_CTRL size 0x1000 — Register map for FLASH_CTRL peripheral
0x400FE000 SYSCTL size 0x1000 — Register map for SYSCTL peripheral
0x400FF000 UDMA size 0x1000 — Register map for UDMA peripheral

## Interrupts
0 GPIOA (GPIOA, GPIOA_AHB)
1 GPIOB (GPIOB, GPIOB_AHB)
2 GPIOC (GPIOC, GPIOC_AHB)
3 GPIOD (GPIOD, GPIOD_AHB)
4 GPIOE (GPIOE, GPIOE_AHB)
5 UART0
6 UART1
7 SSI0
8 I2C0
9 PWM0_FAULT (PWM0)
10 PWM0_0 (PWM0)
11 PWM0_1 (PWM0)
12 PWM0_2 (PWM0)
13 QEI0
14 ADC0SS0 (ADC0)
15 ADC0SS1 (ADC0)
16 ADC0SS2 (ADC0)
17 ADC0SS3 (ADC0)
18 WATCHDOG0 (WATCHDOG0, WATCHDOG1)
19 TIMER0A (TIMER0)
20 TIMER0B (TIMER0)
21 TIMER1A (TIMER1)
22 TIMER1B (TIMER1)
23 TIMER2A (TIMER2)
24 TIMER2B (TIMER2)
25 COMP0 (COMP)
26 COMP1 (COMP)
27 COMP2 (COMP)
28 SYSCTL
29 FLASH_CTRL
30 GPIOF (GPIOF, GPIOF_AHB)
31 GPIOG (GPIOG, GPIOG_AHB)
32 GPIOH (GPIOH, GPIOH_AHB)
33 UART2
34 SSI1
35 TIMER3A (TIMER3)
36 TIMER3B (TIMER3)
37 I2C1
38 QEI1
39 CAN0
40 CAN1
43 HIB
44 USB0
45 PWM0_3 (PWM0)
46 UDMA
47 UDMAERR (UDMA)
48 ADC1SS0 (ADC1)
49 ADC1SS1 (ADC1)
50 ADC1SS2 (ADC1)
51 ADC1SS3 (ADC1)
54 GPIOJ (GPIOJ, GPIOJ_AHB)
55 GPIOK
56 GPIOL
57 SSI2
58 SSI3
59 UART3
60 UART4
61 UART5
62 UART6
63 UART7
68 I2C2
69 I2C3
70 TIMER4A (TIMER4)
71 TIMER4B (TIMER4)
92 TIMER5A (TIMER5)
93 TIMER5B (TIMER5)
94 WTIMER0A (WTIMER0)
95 WTIMER0B (WTIMER0)
96 WTIMER1A (WTIMER1)
97 WTIMER1B (WTIMER1)
98 WTIMER2A (WTIMER2)
99 WTIMER2B (WTIMER2)
100 WTIMER3A (WTIMER3)
101 WTIMER3B (WTIMER3)
102 WTIMER4A (WTIMER4)
103 WTIMER4B (WTIMER4)
104 WTIMER5A (WTIMER5)
105 WTIMER5B (WTIMER5)
106 SYSEXC
109 I2C4
110 I2C5
111 GPIOM
112 GPION
{n+116} GPIOP{n} (GPIOP) (n=0..7)
{n+124} GPIOQ{n} (GPIOQ) (n=0..7)
134 PWM1_0 (PWM1)
135 PWM1_1 (PWM1)
136 PWM1_2 (PWM1)
137 PWM1_3 (PWM1)
138 PWM1_FAULT (PWM1)
