# CC13x0 register map
File version: 2.0
SimpleLink CC13xx Ultra-low power wireless MCU
CPU: CM3 r2p1, little endian, no MPU, no FPU, 0x3 interrupt priority bits, 0x0 interrupts
Registers are 32-bit, read-write, reset 0x0 unless marked. A register's access mark holds for its fields unless they carry their own. Offsets are from the block's base; lines under a group give offsets from that group; [hi:lo] are bit positions; {n}, {i} and the like mark numbered series; 'fields as' and 'values as' point back to an identical list; <NAME> marks a mode.

## Memory map
0x40000000 SSI0 size 0x1000 — Synchronous Serial Interface with master and slave capabilities
0x40001000 UART0 size 0x1000 — Universal Asynchronous Receiver/Transmitter (UART) interface
0x40002000 I2C0 size 0x1000 — I2CMaster/Slave Serial Controler
0x40008000 SSI1 size 0x1000 — Synchronous Serial Interface with master and slave capabilities
0x40010000 GPT0 size 0x1000 — General Purpose Timer.
0x40011000 GPT1 size 0x1000 — General Purpose Timer.
0x40012000 GPT2 size 0x1000 — General Purpose Timer.
0x40013000 GPT3 size 0x1000 — General Purpose Timer.
0x40020000 UDMA0 size 0x1000 — ARM Micro Direct Memory Access Controller
0x40021000 I2S0 size 0x1000 — I2S Audio DMA module supporting formats I2S, LJF, RJF and DSP
0x40022000 GPIO size 0x400 — MCU GPIO - I/F for controlling and reading IO status and IO event status
0x40024000 CRYPTO size 0x800 — Crypto core with DMA capability and local key storage
0x40028000 TRNG size 0x2000 — True Random Number Generator
0x40030000 FLASH size 0x4000 — Flash sub-system registers, includes the Flash Memory Controller (FMC), flash read path, and an integrated Efuse controller and EFUSEROM.
0x40034000 VIMS size 0x400 — Versatile Instruction Memory System Controls memory access to the Flash and encapsulates the following instruction memories: - Boot ROM - Cache / GPRAM
0x40040000 RFC_PWR size 0x4 — RF Core Power Management
0x40041000 RFC_DBELL size 0x40 — RF Core Doorbell
0x40043000 RFC_RAT size 0x100 — RF Core Radio Timer
0x40080000 WDT size 0x1000 — Watchdog Timer
0x40081000 IOC size 0x1000 — IO Controller (IOC) - configures all the DIOs and resides in the MCU domain.
0x40082000 PRCM size 0x1000 — Power, Reset and Clock Management
0x40083000 EVENT size 0x1000 — Event Fabric Component Definition
0x40084000 SMPH size 0x1000 — MCU Semaphore Module This module provides 32 binary semaphores. The state of a binary semaphore is either taken or available. A semaphore does not implement any ownership attribute. Still, a semaphore can be used to handle mutual exclusion scenarios.
0x40090000 AON_SYSCTL size 0x400 — This component controls AON_SYSCTL, which is the device's system controller. Note: This module is only supporting 32 bit ReadWrite access from MCU
0x40091000 AON_WUC size 0x1000 — This component control the Wakeup controller residing in the AON domain. Note: This module is only supporting 32 bit ReadWrite access from MCU
0x40092000 AON_RTC size 0x400 — This component control the Real Time Clock residing in AON Note: This module is only supporting 32 bit ReadWrite access.
0x40093000 AON_EVENT size 0x400 — This module configures the event fabric located in the AON domain. Note: This module is only supporting 32 bit ReadWrite access from MCU
0x40094000 AON_IOC size 0x400 — Always On (AON) IO Controller - controls IO operation when the MCU IO Controller (IOC) is powered off and resides in the AON domain. Note: This module only supports 32 bit Read/Write access from MCU.
0x40095000 AON_BATMON size 0x400 — Always On (AON) Battery And Temperature MONitor (BATMON) residing in the AON domain Note: This module only supports 32 bit Read/Write access from MCU.
0x400C1000 AUX_AIODIO0 size 0x1000 — AUX Analog/Digital Input Output Controller
0x400C2000 AUX_AIODIO1 size 0x1000 — AUX Analog/Digital Input Output Controller
0x400C4000 AUX_TDCIF size 0x1000 — AUX Time To Digital Converter
0x400C5000 AUX_EVCTL size 0x1000 — AUX Event Controller
0x400C6000 AUX_WUC size 0x1000 — AUX Wake-up controller
0x400C7000 AUX_TIMER size 0x1000
0x400C8000 AUX_SMPH size 0x1000 — AUX Semaphore Controller
0x400C9000 AUX_ANAIF size 0x1000 — AUX Analog Peripheral Control Module
0x400CA000 AUX_DDI0_OSC size 0x40 — This is the DDI for the digital block that controls all the analog clock oscillators (OSC_DIG) and performs qualification of the clocks generated.
0x400CB000 AUX_ADI4 size 0x10 — Configuration registers controlling analog peripherals of AUX. Registers Fields should be considered static unless otherwise noted (as dynamic)
0x400E1000 AUX_SCE size 0x1000 — AUX Sensor Control Engine Control Module
0x50001000 FCFG1 size 0x400 — Factory configuration area (FCFG1)
0x50003000 CCFG size 0x1000 — Customer configuration area (CCFG)
0xE00FE000 CPU_TIPROP size 0x1000 — Cortex-M's TI proprietary registers

## Interrupts
0 AON_GPIO_EDGE (EVENT)
4 I2C_IRQ (EVENT)
8 RFC_CPE_1 (EVENT)
16 AON_RTC_COMB (EVENT)
20 UART0_COMB (EVENT)
24 AUX_SWEV0 (EVENT)
28 SSI0_COMB (EVENT)
32 SSI1_COMB (EVENT)
36 RFC_CPE_0 (EVENT)
40 RFC_HW_COMB (EVENT)
44 RFC_CMD_ACK (EVENT)
48 I2S_IRQ (EVENT)
52 AUX_SWEV1 (EVENT)
56 WDT_IRQ (EVENT)
60 GPT0A (EVENT)
64 GPT0B (EVENT)
68 GPT1A (EVENT)
72 GPT1B (EVENT)
76 GPT2A (EVENT)
80 GPT2B (EVENT)
84 GPT3A (EVENT)
88 GPT3B (EVENT)
92 CRYPTO_RESULT_AVAIL_IRQ (EVENT)
96 DMA_DONE_COMB (EVENT)
100 DMA_ERR (EVENT)
104 FLASH (EVENT)
108 SWEV0 (EVENT)
112 AUX_COMB (EVENT)
116 AON_PROG0 (EVENT)
120 PROG0 (EVENT)
124 AUX_COMPA (EVENT)
128 AUX_ADC_IRQ (EVENT)
132 TRNG_IRQ (EVENT)
