# STM32F21x register map
File version: 1.0
CPU: 
Registers are 32-bit, read-write, reset 0x0 unless marked. A register's access mark holds for its fields unless they carry their own. Offsets are from the block's base; lines under a group give offsets from that group; [hi:lo] are bit positions; {n}, {i} and the like mark numbered series; 'fields as' and 'values as' point back to an identical list; <NAME> marks a mode.

## Memory map
0x40000000 TIM2 size 0x400 — General-purpose-timers
0x40000400 TIM3 size 0x400 — General-purpose-timers
0x40000800 TIM4 size 0x400 — General-purpose-timers
0x40000C00 TIM5 size 0x400 — General-purpose-timers
0x40001000 TIM6 size 0x400 — Basic-timers
0x40001400 TIM7 size 0x400 — Basic-timers
0x40001800 TIM12 size 0x400 — General-purpose-timers
0x40001C00 TIM13 size 0x400 — General-purpose-timers
0x40002000 TIM14 size 0x400 — General-purpose-timers
0x40002800 RTC size 0x400 — Real-time clock
0x40002C00 WWDG size 0x400 — Window watchdog
0x40003000 IWDG size 0x400 — Independent watchdog
0x40003800 SPI2 size 0x400 — Serial peripheral interface
0x40003C00 SPI3 size 0x400 — Serial peripheral interface
0x40004400 USART2 size 0x400 — Universal synchronous asynchronous receiver transmitter
0x40004800 USART3 size 0x400 — Universal synchronous asynchronous receiver transmitter
0x40004C00 UART4 size 0x400 — Universal synchronous asynchronous receiver transmitter
0x40005000 UART5 size 0x400 — Universal synchronous asynchronous receiver transmitter
0x40005400 I2C1 size 0x400 — Inter-integrated circuit
0x40005800 I2C2 size 0x400 — Inter-integrated circuit
0x40005C00 I2C3 size 0x400 — Inter-integrated circuit
0x40006400 CAN1 size 0x400 — Controller area network
0x40006800 CAN2 size 0x400 — Controller area network
0x40007000 PWR size 0x400 — Power control
0x40007400 DAC size 0x400 — Digital-to-analog converter
0x40010000 TIM1 size 0x400 — Advanced-timers
0x40010400 TIM8 size 0x400 — Advanced-timers
0x40011000 USART1 size 0x400 — Universal synchronous asynchronous receiver transmitter
0x40011400 USART6 size 0x400 — Universal synchronous asynchronous receiver transmitter
0x40012000 ADC1 size 0x400 — Analog-to-digital converter
0x40012100 ADC2 size 0x400 — Analog-to-digital converter
0x40012200 ADC3 size 0x400 — Analog-to-digital converter
0x40012300 ADC_Common size 0x400 — Common ADC registers
0x40012C00 SDIO size 0x400 — Secure digital input/output interface
0x40013000 SPI1 size 0x400 — Serial peripheral interface
0x40013800 SYSCFG size 0x400 — System configuration controller
0x40013C00 EXTI size 0x400 — External interrupt/event controller
0x40014000 TIM9 size 0x400 — General-purpose-timers
0x40014400 TIM10 size 0x400 — General-purpose-timers
0x40014800 TIM11 size 0x400 — General-purpose-timers
0x40020000 GPIOA size 0x400 — General-purpose I/Os
0x40020400 GPIOB size 0x400 — General-purpose I/Os
0x40020800 GPIOC size 0x400 — General-purpose I/Os
0x40020C00 GPIOD size 0x400 — General-purpose I/Os
0x40021000 GPIOE size 0x400 — General-purpose I/Os
0x40021400 GPIOF size 0x400 — General-purpose I/Os
0x40021800 GPIOG size 0x400 — General-purpose I/Os
0x40021C00 GPIOH size 0x400 — General-purpose I/Os
0x40022000 GPIOI size 0x400 — General-purpose I/Os
0x40023000 CRC size 0x400 — cyclic redundancy check calculation unit
0x40023800 RCC size 0x400 — Reset and clock control
0x40023C00 FLASH size 0x400
0x40026000 DMA1 size 0x400 — DMA controller
0x40026400 DMA2 size 0x400 — DMA controller
0x40028000 Ethernet_MAC size 0x400 — Ethernet: media access control (MAC)
0x40028100 Ethernet_MMC size 0x400 — Ethernet: MAC management counters
0x40028700 Ethernet_PTP size 0x400 — Ethernet: Precision time protocol
0x40029000 Ethernet_DMA size 0x400 — Ethernet: DMA controller operation
0x40040000 OTG_HS_GLOBAL size 0x400 — USB on the go high speed
0x40040400 OTG_HS_HOST size 0x400 — USB on the go high speed
0x40040800 OTG_HS_DEVICE size 0x400 — USB on the go high speed
0x40040E00 OTG_HS_PWRCLK size 0x3F200 — USB on the go high speed
0x50000000 OTG_FS_GLOBAL size 0x400 — USB on the go full speed
0x50000400 OTG_FS_HOST size 0x400 — USB on the go full speed
0x50000800 OTG_FS_DEVICE size 0x400 — USB on the go full speed
0x50000E00 OTG_FS_PWRCLK size 0x400 — USB on the go full speed
0x50050000 DCMI size 0x400 — Digital camera interface
0x50060000 CRYP size 0x400 — Cryptographic processor
0x50060400 HASH size 0x400 — Hash processor
0x50060800 RNG size 0x400 — Random number generator
0xA0000000 FSMC size 0x1000 — Flexible static memory controller
0xE000E000 NVIC size 0x1001 — Nested Vectored Interrupt Controller
0xE0042000 DBG size 0x400 — Debug support

## Interrupts
0 WWDG
1 PVD (PWR)
2 TAMP_STAMP (EXTI)
3 RTC_WKUP (RTC)
4 FLASH
5 RCC
6 EXTI0 (EXTI)
7 EXTI1 (EXTI)
8 EXTI2 (EXTI)
9 EXTI3 (EXTI)
10 EXTI4 (EXTI)
11 DMA1_Stream0 (DMA1)
12 DMA1_Stream1 (DMA1)
13 DMA1_Stream2 (DMA1)
14 DMA1_Stream3 (DMA1)
15 DMA1_Stream4 (DMA1)
16 DMA1_Stream5 (DMA1)
17 DMA1_Stream6 (DMA1)
18 ADC (ADC{n} (n=1..3))
19 CAN1_TX (CAN1)
20 CAN1_RX0 (CAN1)
21 CAN1_RX1 (CAN1)
22 CAN1_SCE (CAN1)
23 EXTI9_5 (EXTI)
24 TIM1_BRK_TIM9 (TIM1, TIM9)
25 TIM1_UP_TIM10 (TIM1, TIM10)
26 TIM1_TRG_COM_TIM11 (TIM1, TIM11)
27 TIM1_CC (TIM1)
28 TIM2
29 TIM3
30 TIM4
31 I2C1_EV (I2C1)
32 I2C1_ER (I2C1)
33 I2C2_EV (I2C2)
34 I2C2_ER (I2C2)
35 SPI1
36 SPI2
37 USART1
38 USART2
39 USART3
40 EXTI15_10 (EXTI)
41 RTC_Alarm (RTC)
42 OTG_FS_WKUP (OTG_FS_GLOBAL)
43 TIM8_BRK_TIM12 (TIM8, TIM12)
44 TIM8_UP_TIM13 (TIM8, TIM13)
45 TIM8_TRG_COM_TIM14 (TIM8, TIM14)
46 TIM8_CC (TIM8)
47 DMA1_Stream7 (DMA1)
48 FSMC
49 SDIO
50 TIM5
51 SPI3
52 UART4
53 UART5
54 TIM6_DAC (DAC, TIM6)
55 TIM7
56 DMA2_Stream0 (DMA2)
57 DMA2_Stream1 (DMA2)
58 DMA2_Stream2 (DMA2)
59 DMA2_Stream3 (DMA2)
60 DMA2_Stream4 (DMA2)
61 ETH (Ethernet_MAC)
62 ETH_WKUP (Ethernet_MAC)
63 CAN2_TX (CAN2)
64 CAN2_RX0 (CAN2)
65 CAN2_RX1 (CAN2)
66 CAN2_SCE (CAN2)
67 OTG_FS (OTG_FS_GLOBAL)
68 DMA2_Stream5 (DMA2)
69 DMA2_Stream6 (DMA2)
70 DMA2_Stream7 (DMA2)
71 USART6
72 I2C3_EV (I2C3)
73 I2C3_ER (I2C3)
74 OTG_HS_EP1_OUT (OTG_HS_GLOBAL)
75 OTG_HS_EP1_IN (OTG_HS_GLOBAL)
76 OTG_HS_WKUP (OTG_HS_GLOBAL)
77 OTG_HS (OTG_HS_GLOBAL)
78 DCMI
79 CRYP
80 HASH_RNG (RNG, HASH)
