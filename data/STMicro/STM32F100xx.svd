# STM32F100xx register map
File version: 1.1
CPU: 
Registers are 32-bit, read-write, reset 0x0 unless marked. A register's access mark holds for its fields unless they carry their own. Offsets are from the block's base; lines under a group give offsets from that group; [hi:lo] are bit positions; {n}, {i} and the like mark numbered series; 'fields as' and 'values as' point back to an identical list; <NAME> marks a mode.

## Memory map
0x40000000 TIM2 size 0x400 — General purpose timer
0x40000400 TIM3 size 0x400 — General purpose timer
0x40000800 TIM4 size 0x400 — General purpose timer
0x40000C00 TIM5 size 0x400 — General purpose timer
0x40001000 TIM6 size 0x400 — Basic timer
0x40001400 TIM7 size 0x400 — Basic timer
0x40001800 TIM12 size 0x400 — General purpose timer
0x40001C00 TIM13 size 0x400 — General purpose timer
0x40002000 TIM14 size 0x400 — General purpose timer
0x40002800 RTC size 0x400 — Real time clock
0x40002C00 WWDG size 0x400 — Window watchdog
0x40003000 IWDG size 0x400 — Independent watchdog
0x40003800 SPI2 size 0x400 — Serial peripheral interface
0x40003C00 SPI3 size 0x400 — Serial peripheral interface
0x40004400 USART2 size 0x400 — Universal synchronous asynchronous receiver transmitter
0x40004800 USART3 size 0x400 — Universal synchronous asynchronous receiver transmitter
0x40004C00 UART4 size 0x400 — Universal asynchronous receiver transmitter
0x40005000 UART5 size 0x400 — Universal asynchronous receiver transmitter
0x40005400 I2C1 size 0x400 — Inter integrated circuit
0x40005800 I2C2 size 0x400 — Inter integrated circuit
0x40006C04 BKP size 0x400 — Backup registers
0x40007000 PWR size 0x400 — Power control
0x40007400 DAC size 0x400 — Digital to analog converter
0x40007800 CEC size 0x400 — HDMI-CEC controller
0x40010000 AFIO size 0x400 — Alternate function I/O
0x40010400 EXTI size 0x400
0x40010800 GPIOA size 0x400 — General purpose I/O
0x40010C00 GPIOB size 0x400 — General purpose I/O
0x40011000 GPIOC size 0x400 — General purpose I/O
0x40011400 GPIOD size 0x400 — General purpose I/O
0x40011800 GPIOE size 0x400 — General purpose I/O
0x40011C00 GPIOF size 0x400 — General purpose I/O
0x40012000 GPIOG size 0x400 — General purpose I/O
0x40012400 ADC1 size 0x400 — Analog to digital converter
0x40012C00 TIM1 size 0x400 — Advanced timer
0x40013000 SPI1 size 0x400 — Serial peripheral interface
0x40013800 USART1 size 0x400 — Universal synchronous asynchronous receiver transmitter
0x40014000 TIM15 size 0x400 — General purpose timers
0x40014400 TIM16 size 0x400 — General-purpose-timers
0x40014800 TIM17 size 0x400 — General-purpose-timers
0x40020000 DMA1 size 0x400 — DMA controller
0x40020400 DMA2 size 0x400 — DMA controller
0x40021000 RCC size 0x400 — Reset and clock control
0x40022000 FLASH size 0x400
0x40023000 CRC size 0x400 — CRC calculation unit
0xA0000000 FSMC size 0x1000 — Flexible static memory controller
0xE000E000 NVIC size 0x1001 — Nested Vectored Interrupt Controller
0xE0042000 DBG size 0x400 — Debug support

## Interrupts
0 WWDG_IRQ (WWDG)
1 PVD_IRQ (PWR)
2 TAMPER_STAMP_IRQ (EXTI)
3 RTC_WKUP_IRQ (RTC)
4 FLASH_IRQ (FLASH)
5 RCC_IRQ (RCC)
6 EXTI0_IRQ (EXTI)
7 EXTI1_IRQ (EXTI)
8 EXTI2_IRQ (EXTI)
9 EXTI3_IRQ (EXTI)
10 EXTI4_IRQ (EXTI)
11 DMA1_Channel1_IRQ (DMA1)
12 DMA1_Channel2_IRQ (DMA1)
13 DMA1_Channel3_IRQ (DMA1)
14 DMA1_Channel4_IRQ (DMA1)
15 DMA1_Channel5_IRQ (DMA1)
16 DMA1_Channel6_IRQ (DMA1)
17 DMA1_Channel7_IRQ (DMA1)
18 ADC_IRQ (ADC1)
23 EXTI9_5_IRQ (EXTI)
24 TIM1_BRK_TIM15_IRQ (TIM1, TIM15)
25 TIM1_UP_TIM16_IRQ (TIM1, TIM16)
26 TIM1_TRG_COM_TIM17_IRQ (TIM1, TIM17)
27 TIM1_CC_IRQ (TIM1)
28 TIM2_IRQ (TIM2)
29 TIM3_IRQ (TIM3)
30 TIM4_IRQ (TIM4)
31 I2C1_EV_IRQ (I2C1)
32 I2C1_ER_IRQ (I2C1)
33 I2C2_EV_IRQ (I2C2)
34 I2C2_ER_IRQ (I2C2)
35 SPI1_IRQ (SPI1)
36 SPI2_IRQ (SPI2)
37 USART1_IRQ (USART1)
38 USART2_IRQ (USART2)
39 USART3_IRQ (USART3)
40 EXTI15_10_IRQ (EXTI)
41 RTCAlarm_IRQ (RTC)
42 CEC_IRQ (CEC)
43 TIM12_IRQ (TIM12)
44 TIM13_IRQ (TIM13, TIM14)
48 FSMC_IRQ (FSMC)
50 TIM5_IRQ (TIM5)
51 SPI3_IRQ (SPI3)
52 UART4_IRQ (UART4)
53 UART5_IRQ (UART5)
54 TIM6_DAC_IRQ (TIM6, DAC)
55 TIM7_IRQ (TIM7)
56 DMA2_Channel1_IRQ (DMA2)
57 DMA2_Channel2_IRQ (DMA2)
58 DMA2_Channel3_IRQ (DMA2)
59 DMA2_Channel4_5_IRQ (DMA2)
