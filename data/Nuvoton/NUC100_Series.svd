# NUC1xx_registers register map
File version: 0.1
CPU: 
Registers are 32-bit, read-write, reset 0x0 unless marked. A register's access mark holds for its fields unless they carry their own. Offsets are from the block's base; [hi:lo] are bit positions; lines under a group give offsets from that group; {n}, {i} and the like mark numbered series.

## INT — Registers group
Base 0x50000300
0x00 IRQ0_SRC ro reset not defined — MCU IRQ0 (BOD) interrupt source identify
  [2:0] INT_SRC — Bit2: 0 Bit1: 0 Bit0: BOD_INT
0x04 IRQ1_SRC ro reset not defined — MCU IRQ1 (WDG) interrupt source identify
  [2:0] INT_SRC — Bit2: 0 Bit1: 0 Bit0: WDG_INT
0x08 IRQ2_SRC ro reset not defined — MCU IRQ2 (EINT0) interrupt source identify
  [2:0] INT_SRC — Bit2: 0 Bit1: 0 Bit0: EINT0 - external interrupt 0 from PB.14
0x0C IRQ3_SRC ro reset not defined — MCU IRQ3 (EINT1) interrupt source identify
  [2:0] INT_SRC — Bit2: 0 Bit1: 0 Bit0: EINT1 - external interrupt 1 from PB.15
0x10 IRQ4_SRC ro reset not defined — MCU IRQ4 (GPA/B) interrupt source identify
  [2:0] INT_SRC — Bit2: 0 Bit1: GPB_INT Bit0: GPA_INT
0x14 IRQ5_SRC ro reset not defined — MCU IRQ5 (GPC/D/E) interrupt source identify
  [2:0] INT_SRC — Bit2: GPE_INT Bit1: GPD_INT Bit0: GPC_INT
0x18 IRQ6_SRC ro reset not defined — MCU IRQ6 (PWMA) interrupt source identify
  [2:0] INT_SRC — Bit3: PWM3_INT Bit2: PWM2_INT Bit1: PWM1_INT Bit0: PWM0_INT
0x1C IRQ7_SRC ro reset not defined — MCU IRQ7 (PWMB) interrupt source identify
  [2:0] INT_SRC — Bit3: PWM7_INT Bit2: PWM6_INT Bit1: PWM5_INT Bit0: PWM4_INT
{0x0+4i} IRQ{i}_SRC ro reset not defined (i=8..11) — MCU IRQ{i} (TMR{i-8}) interrupt source identify
  [2:0] INT_SRC — Bit2: 0 Bit1: 0 Bit0: TMR{i-8}_INT
0x30 IRQ12_SRC ro reset not defined — MCU IRQ12 (URT0) interrupt source identify
  [2:0] INT_SRC — Bit2: 0 Bit1: 0 Bit0: URT0_INT
0x34 IRQ13_SRC ro reset not defined — MCU IRQ13 (URT1) interrupt source identify
  [2:0] INT_SRC — Bit2: 0 Bit1: 0 Bit0: URT1_INT
{0x0+4i} IRQ{i}_SRC ro reset not defined (i=14..17) — MCU IRQ{i} (SPI{i-14}) interrupt source identify
  [2:0] INT_SRC — Bit2: 0 Bit1: 0 Bit0: SPI{i-14}_INT
0x48 IRQ18_SRC ro reset not defined — MCU IRQ18 (I2C0) interrupt source identify
  [2:0] INT_SRC — Bit2: 0 Bit1: 0 Bit0: I2C0_INT
0x4C IRQ19_SRC ro reset not defined — MCU IRQ19 (I2C1) interrupt source identify
  [2:0] INT_SRC — Bit2: 0 Bit1: 0 Bit0: I2C1_INT
0x50 IRQ20_SRC ro reset not defined — MCU IRQ20 (CAN0) interrupt source identify
  [2:0] INT_SRC — Bit2: 0 Bit1: 0 Bit0: CAN0_INT
0x54 IRQ21_SRC ro reset not defined — MCU IRQ21 (Reserved) interrupt source identity
  [2:0] INT_SRC — Reserved
0x58 IRQ22_SRC ro reset not defined — MCU IRQ22 (Reserved) interrupt source identify
  [2:0] INT_SRC — Reserved
0x5C IRQ23_SRC ro reset not defined — MCU IRQ23 (USBD) interrupt source identify
  [2:0] INT_SRC — Bit2: 0 Bit1: 0 Bit0: USBD_INT
0x60 IRQ24_SRC ro reset not defined — MCU IRQ24 (PS2) interrupt source identify
  [2:0] INT_SRC — Bit2: 0 Bit1: 0 Bit0: PS2_INT
0x64 IRQ25_SRC ro reset not defined — MCU IRQ25 (ACMP) interrupt source identify
  [2:0] INT_SRC — Bit2: 0 Bit1: 0 Bit0: ACMP_INT
0x68 IRQ26_SRC ro reset not defined — MCU IRQ26 (PDMA) interrupt source identify
  [2:0] INT_SRC — Bit2: 0 Bit1: 0 Bit0: PDMA_INT
0x6C IRQ27_SRC ro reset not defined — MCU IRQ27 (Reserved) interrupt source identify
  [2:0] INT_SRC — Bit2: 0 Bit1: 0 Bit0: I2S_INT
0x70 IRQ28_SRC ro reset not defined — MCU IRQ28 (PWRWU) interrupt source identify
  [2:0] INT_SRC — Bit2: 0 Bit1: 0 Bit0: PWRWU_INT
0x74 IRQ29_SRC ro reset not defined — MCU IRQ29 (ADC) interrupt source identify
  [2:0] INT_SRC — Bit2: 0 Bit1: 0 Bit0: ADC_INT
0x78 IRQ30_SRC ro reset not defined — MCU IRQ30 (Reserved) interrupt source identify
  [2:0] INT_SRC — Reserved
0x7C IRQ31_SRC ro reset not defined — MCU IRQ31 (RTC) interrupt source identify
  [2:0] INT_SRC — Bit2: 0 Bit1: 0 Bit0: RTC_INT
0x80 NMI_SEL — NMI source interrupt select control register
  [4:0] NMI_SEL — The NMI interrupt to Cortex-M0 can be selected from one of the peripheral interrupt by setting NMI_SEL.
0x84 MCU_IRQ — MCU IRQ Number identify register
  [31:0] MCU_IRQ — MCU IRQ Source Register The MCU_IRQ collect all the interrupts from the peripherals and generate the synchronous interrupt to MCU Cortex-M0. There are two modes to generate interrupt to MCU Cortex-M0, the normal mode and test mode. The MCU_IRQ collect all interrupt from each peripheral and synchronize them then interrupt the Cortex-M0. When the MCU_IRQ[n] is "0": Set MCU_IRQ[n] "1" will generate a interrupt to Cortex_M0 NVIC[n]. When the MCU_IRQ[n] is "1" (mean a interrupt is assert) set "1" to the MCU_bit[n] will clear the interrupt. Set MCU_IRQ[n] "0": no any effect
