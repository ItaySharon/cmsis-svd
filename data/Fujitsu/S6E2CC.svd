# S6E2CC register map
File version: 1.1
CPU: 
Registers are 8-bit, read-write, reset 0x0 unless marked. A register's access mark holds for its fields unless they carry their own. Offsets are from the block's base; lines under a group give offsets from that group; [hi:lo] are bit positions; {n}, {i} and the like mark numbered series; 'fields as' and 'values as' point back to an identical list; <NAME> marks a mode.

## Memory map
0x40000000 FLASH_IF size 0xC — Flash Memory
0x40000200 UNIQUE_ID size 0x4
0x40000300 ECC_CAPTURE size 0x4 — ECC Capture Address
0x40000400 DUALFLASH_IF size 0x4 — Dual Flash Memory
0x40010000 CRG size 0x70 — Clock Unit Registers
0x40011000 HWWDT size 0x4 — Hardware Watchdog Timer
0x40012000 SWWDT size 0x4 — Software Watchdog Timer
0x40015000 DTIM size 0x1C — Dual Timer
0x40020000 MFT0 size 0x1ED — Multifunction Timer 0
0x40021000 MFT1 size 0x1ED — Multifunction Timer 0
0x40022000 MFT2 size 0x1ED — Multifunction Timer 0
0x40024000 MFT_PPG size 0x2 — PPG Configuration
0x40025000 BT0 size 0x2 — Base Timer 0
0x40025040 BT1 size 0x2 — Base Timer 0
0x40025080 BT2 size 0x2 — Base Timer 0
0x400250C0 BT3 size 0x2 — Base Timer 0
0x40025100 BTIOSEL03 size 0x2 — Base Timer I/O Select
0x40025200 BT4 size 0x2 — Base Timer 0
0x40025240 BT5 size 0x2 — Base Timer 0
0x40025280 BT6 size 0x2 — Base Timer 0
0x400252C0 BT7 size 0x2 — Base Timer 0
0x40025300 BTIOSEL47 size 0x2 — Base Timer I/O Select
0x40025400 BT8 size 0x2 — Base Timer 0
0x40025440 BT9 size 0x2 — Base Timer 0
0x40025480 BT10 size 0x2 — Base Timer 0
0x400254C0 BT11 size 0x2 — Base Timer 0
0x40025500 BTIOSEL8B size 0x2 — Base Timer I/O Select
0x40025600 BT12 size 0x2 — Base Timer 0
0x40025640 BT13 size 0x2 — Base Timer 0
0x40025680 BT14 size 0x2 — Base Timer 0
0x400256C0 BT15 size 0x2 — Base Timer 0
0x40025700 BTIOSELCF size 0x2 — Base Timer I/O Select
0x40025F00 SBSSR blocks up to offset 0xFE — Software-based Simultaneous Startup Register
0x40026000 QPRC0 size 0x2 — Quadrature Position/Revolution Counter 0
0x40026040 QPRC1 size 0x2 — Quadrature Position/Revolution Counter 0
0x40026080 QPRC2 size 0x2 — Quadrature Position/Revolution Counter 0
0x400260C0 QPRC3 size 0x2 — Quadrature Position/Revolution Counter 0
0x40026100 QPRC0_NF size 0x1 — Quadrature Position/Revolution Counter 0 Noise Filter
0x40026110 QPRC1_NF size 0x1 — Quadrature Position/Revolution Counter 0 Noise Filter
0x40026120 QPRC2_NF size 0x1 — Quadrature Position/Revolution Counter 0 Noise Filter
0x40026130 QPRC3_NF size 0x1 — Quadrature Position/Revolution Counter 0 Noise Filter
0x40027000 ADC0 size 0x2 — ADC0 Registers
0x40027100 ADC1 size 0x2 — ADC0 Registers
0x40027200 ADC2 size 0x2 — ADC0 Registers
0x4002E000 CRTRIM size 0x1 — CR Trimming Registers
0x40030000 EXTI size 0x4 — External Interrupt and NMI Control
0x40031000 INTREQ size 0x4 — Interrupts
0x40033000 DAC0 size 0x1 — D/A Converter 0
0x40033008 DAC1 size 0x1 — D/A Converter 0
0x40034000 HDMICEC0 size 0x1 — HDMI-CEC ch.0
0x40034100 HDMICEC1 size 0x1 — HDMI-CEC ch.0
0x40035000 LVD size 0x1 — Low-voltage Detection
0x40035100 DS blocks up to offset 0x5 — Low Power Consumption Mode
0x40036000 USBETHERCLK size 0x1 — USB/Ethernet Clock
0x40037000 CANPRES size 0x1 — CAN Prescaler Register
{0x40038000+0x100*n} MFS{n} size 0x2 (n=0..15) — Multi-function Serial Interface 0
0x40039000 CRC size 0x1 — CRC Registers
0x4003A000 WC size 0x3 — Watch Counter
0x4003B000 RTC size 0x1B1 — REAL-TIME CLOCK
0x4003C000 LCR size 0x1 — Low-speed CR Prescaler
0x4003C100 CLK_GATING size 0x4 — Peripheral Clock Gating
0x4003C800 PLL_CONTROL size 0x8 — Main PLL Control
0x4003D000 I2SPRE size 0x4 — I2S Clock Generation
0x4003F000 EXBUS size 0x80 — External Bus Interface
0x40040000 USB0 blocks up to offset 0x2102 — USB0 Function
0x40050000 USB1 blocks up to offset 0x2102 — USB0 Function
0x40060000 DMAC size 0x4 — DMAC Registers
0x40061000 DSTC size 0xB0 — DSTC registers
0x40062000 CAN0 size 0xE — CAN0 Registers
0x40063000 CAN1 size 0xE — CAN0 Registers
0x40064000 ETHERNET_MAC0 size 0x1058
0x40066000 ETHERNET_CONTROL size 0x4 — Ethernet system control
0x4006C000 I2S0 size 0x4 — I2S
0x4006E000 SDIF size 0x1000 — SD Card Interface
0x4006F000 GPIO size 0x780 — 0
0x40070000 CANFD size 0x4 — CAN FD Registers
0x40080000 PCRC size 0x4 — 0
0xD0000000 HSSPI size 0x4 — HI-SPEED SPI Controller

## Interrupts
0 CSV (CRG)
1 SWDT (SWWDT)
2 LVD
{n+11} EXINT{n} (EXTI) (n=0..7)
19 QPRC0
20 QPRC1
21 WFG0_DTIF0 (MFT0)
22 WFG1_DTIF1 (MFT1)
23 WFG2_DTIF2 (MFT2)
24 FRT0_PEAK (MFT0)
25 FRT0_ZERO (MFT0)
26 ICU0 (MFT0)
27 OCU0 (MFT0)
28 FRT1_PEAK (MFT1)
29 FRT1_ZERO (MFT1)
30 ICU1 (MFT1)
31 OCU1 (MFT1)
32 FRT2_PEAK (MFT2)
33 FRT2_ZERO (MFT2)
34 ICU2 (MFT2)
35 OCU2 (MFT2)
36 PPG00_02_04 (MFT_PPG)
37 PPG08_10_12 (MFT_PPG)
38 PPG16_18_20 (MFT_PPG)
39 BT0 (BT0, BT{n} (n=13..15))
40 BT1
41 BT2
42 BT3
43 BT4
44 BT5
45 BT6
46 BT7
47 DT1_2 (DTIM)
48 WC
49 EXTBUS_ERR (EXBUS)
50 RTC
{n+43} EXINT{n} (EXTI) (n=8..15)
59 TIM (CRG, I2SPRE)
{2n+60} MFS{n}_RX (MFS{n}) (n=0..7)
{2n+61} MFS{n}_TX (MFS{n}) (n=0..7)
76 ADC0
77 ADC1
78 USB0
79 USB0_HOST (USB0)
80 CAN0
81 CAN1
82 ETHER0 (ETHERNET_MAC0)
{n+83} DMAC{n} (DMAC) (n=0..7)
91 DSTC
92 EXINT16_17_18_19 (EXTI)
93 EXINT20_21_22_23 (EXTI)
94 EXINT24_25_26_27 (EXTI)
95 EXINT28_29_30_31 (EXTI)
96 QPRC2
97 QPRC3
98 BT8
99 BT9
100 BT10
101 BT11
102 BT12_13_14_15 (BT12)
103 MFS8_RX (MFS8)
104 MFS8_TX (MFS8)
105 MFS9_RX (MFS9)
106 MFS9_TX (MFS9)
107 MFS10_RX (MFS10)
108 MFS10_TX (MFS10)
109 MFS11_RX (MFS11)
110 MFS11_TX (MFS11)
111 ADC2
113 USB1_HDMICEC0 (HDMICEC0, USB1)
114 USB1_HOST_HDMICEC1 (HDMICEC1, USB1)
115 HSSPI
117 PRGCRC_I2S (I2S0, PCRC)
118 SD (SDIF)
119 FLASH (FLASH_IF)
120 MFS12_RX (MFS12)
121 MFS12_TX (MFS12)
122 MFS13_RX (MFS13)
123 MFS13_TX (MFS13)
124 MFS14_RX (MFS14)
125 MFS14_TX (MFS14)
126 MFS15_RX (MFS15)
127 MFS15_TX (MFS15)
